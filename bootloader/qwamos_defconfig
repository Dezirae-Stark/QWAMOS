## bootloader/qwamos_defconfig
```kconfig
# QWAMOS U-Boot Configuration
# Post-Quantum Secure Boot with Kyber-1024
# Target: ARM64 (aarch64) for QEMU and physical devices

CONFIG_ARM=y
CONFIG_ARCH_CPU_INIT=y
CONFIG_ARM64=y
CONFIG_TARGET_QEMU_ARM64=y
CONFIG_SYS_TEXT_BASE=0x40000000
CONFIG_NR_DRAM_BANKS=1
CONFIG_ENV_SIZE=0x40000
CONFIG_DEFAULT_DEVICE_TREE="qemu-arm64"
CONFIG_IDENT_STRING=" QWAMOS"
CONFIG_SYS_LOAD_ADDR=0x40200000

# Boot configuration
CONFIG_DISTRO_DEFAULTS=y
CONFIG_BOOTDELAY=3
CONFIG_USE_BOOTCOMMAND=y
CONFIG_BOOTCOMMAND="run qwamos_boot"

# Kyber-1024 Secure Boot
CONFIG_FIT=y
CONFIG_FIT_SIGNATURE=y
CONFIG_FIT_VERBOSE=y
CONFIG_RSA=n
CONFIG_ASYMMETRIC_KEY_TYPE=y

# Cryptography support
CONFIG_SHA256=y
CONFIG_SHA512=y

# Memory configuration
CONFIG_SYS_MALLOC_LEN=0x4000000
CONFIG_SYS_BOOTM_LEN=0x4000000

# Serial console
CONFIG_BAUDRATE=115200
CONFIG_SYS_CBSIZE=512
CONFIG_SYS_MAXARGS=64

# Storage support
CONFIG_MMC=y
CONFIG_DM_MMC=y
CONFIG_MMC_SDHCI=y
CONFIG_MMC_SDHCI_SDMA=y
CONFIG_CMD_MMC=y

# Filesystem support
CONFIG_FS_EXT4=y
CONFIG_CMD_EXT4=y
CONFIG_CMD_EXT4_WRITE=y
CONFIG_CMD_FAT=y
CONFIG_FAT_WRITE=y

# Networking (for development)
CONFIG_NET=y
CONFIG_CMD_NET=y
CONFIG_CMD_PING=y
CONFIG_CMD_DHCP=y
CONFIG_NETDEVICES=y
CONFIG_E1000=y
CONFIG_RTL8139=y
CONFIG_VIRTIO_NET=y

# USB support
CONFIG_USB=y
CONFIG_DM_USB=y
CONFIG_USB_EHCI_HCD=y
CONFIG_USB_STORAGE=y
CONFIG_CMD_USB=y

# Command line interface
CONFIG_CMD_BOOTD=y
CONFIG_CMD_BOOTM=y
CONFIG_CMD_BOOTZ=y
CONFIG_CMD_GO=y
CONFIG_CMD_RUN=y
CONFIG_CMD_IMI=y
CONFIG_CMD_IMLS=y
CONFIG_CMD_XIMG=y

# Environment
CONFIG_CMD_EXPORTENV=y
CONFIG_CMD_IMPORTENV=y
CONFIG_CMD_EDITENV=y
CONFIG_CMD_SAVEENV=y
CONFIG_ENV_IS_IN_MMC=y

# Memory commands
CONFIG_CMD_MEMORY=y
CONFIG_CMD_MD5SUM=y
CONFIG_CMD_SHA1SUM=y
CONFIG_HASH_VERIFY=y

# Device tree
CONFIG_OF_CONTROL=y
CONFIG_OF_BOARD=y

# Debugging
CONFIG_DEBUG_UART=y
CONFIG_DEBUG_UART_PL011=y
CONFIG_LOG=y
CONFIG_LOGLEVEL=6

# QEMU specific
CONFIG_QEMU_ARM64=y
CONFIG_VIRTIO_PCI=y
CONFIG_VIRTIO_BLK=y
CONFIG_DM_RNG=y
CONFIG_RNG_VIRTIO=y

# Disable features not needed
CONFIG_ANDROID_BOOT_IMAGE=n
CONFIG_SPL=n
CONFIG_TPL=n
```
